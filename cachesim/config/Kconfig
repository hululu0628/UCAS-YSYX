## cachesim/config/Kconfig
```kconfig
config INDEX_LEN
  int "length of index"
  default 4

config OFFSET_LEN
  int "offset length"
  default 5

config BLOCK_NUM
  int "block number"
  default 1

choice
  prompt "Replacement Algorithm"
  default LRU
config LRU
  bool "Least Recently Used"
config PLRU
  bool "Pseudo Least Recently Used"
config FIFO
  bool "First In First Out"

endchoice
```

## nemu/src/memory/Kconfig
```kconfig
menu "SoC Configuration"

config MROM
  bool "Enable MROM

config MROM_BASE
  depends on MROM
  hex "MROM base address"
  default 0x20000000

config MROM_SIZE
  depends on MROM
  hex "MROM size"
  default 0x1000

config SRAM
  bool "Enable SRAM"

config SRAM_BASE
  depends on SRAM
  hex "SRAM base address"
  default 0xf000000

config SRAM_SIZE
  depends on SRAM
  hex "SRAM size"
  default 0x1000000

config FLASH
  bool "Enable FLASH"

config FLASH_BASE
  depends on FLASH
  hex "FLASH base address"
  default 0x30000000

config FLASH_SIZE
  depends on FLASH
  hex "FLASH size"
  default 0x10000000

config PSRAM
  bool "Enable PSRAM"

config PSRAM_BASE
  depends on PSRAM
  hex "PSRAM base address"
  default 0x80000000

config PSRAM_SIZE
  depends on PSRAM
  hex "PSRAM size"
  default 0x400000

config SDRAM
  bool "Enable SDRAM"

config SDRAM_BASE
  depends on SDRAM
  hex "SDRAM base address"
  default 0xa0000000

config SDRAM_SIZE
  depends on SDRAM
  hex "SDRAM size"
  default 0x8000000

config RESET_BASE
  hex "Base of reset vector"
  default 0x30000000

config PC_RESET_OFFSET
  hex "Offset of reset vector from the base of memory"
  default 0x100000 if ISA_x86
  default 0

choice
  prompt "Physical memory definition"
  default PMEM_GARRAY
config PMEM_MALLOC
  bool "Using malloc()"
config PMEM_GARRAY
  depends on !TARGET_AM
  bool "Using global array"
endchoice

config MEM_RANDOM
  depends on MODE_SYSTEM && !DIFFTEST && !TARGET_AM
  bool "Initialize the memory with random values"
  default y
  help
    This may help to find undefined behaviors.

endmenu #MEMORY
```

## npc/config/Kconfig
```kconfig
menu "Memory Configuration"

config MBASE
  hex "Memory base address"
  default 0x0        if ISA_x86
  default 0x20000000

config MSIZE
  hex "Memory size"
  default 0x1000

choice
  prompt "Physical memory definition"
  default PMEM_GARRAY
config PMEM_MALLOC
  bool "Using malloc()"
config PMEM_GARRAY
  depends on !TARGET_AM
  bool "Using global array"
endchoice

endmenu

menu "Testing and Debugging"

config AUTOQUIT_CYCLE
  int "Auto quit after blocked for cycles"
  default 1000

config TRACE
  bool "Enable tracer"
  default y

config TRACE_START
  depends on TRACE
  int "When tracing is enabled (unit: number of instructions)"
  default 0

config TRACE_END
  depends on TRACE
  int "When tracing is disabled (unit: number of instructions)"
  default 10000

config ITRACE
  depends on TRACE
  bool "Enable instruction tracer"
  default y

config ITRACE_OUTPUT
  depends on ITRACE
  bool "Only trace instructions when the condition is true"
  default y

config ITRACE_DISASM
  depends on ITRACE
  bool "Onliy trace disasmmebled instructions when the condition is true"
  default n

config IRINGBUF
  depends on ITRACE
  bool "Enable instruction ring buffer"
  default n

config MTRACE
  depends on TRACE
  bool "Enable memory tracer"
  default n

config MTRACE_START
  depends on MTRACE
  hex "When memory tracing is enabled"
  default 0x20000000

config MTRACE_END
  depends on MTRACE
  hex "When memory tracing is disabled"
  default 0x20001000

config FTRACE
  depends on TRACE
  bool "Enable function tracer"
  default n

config DTRACE
  depends on TRACE
  bool "Enable data tracer"
  default n

config ETRACE
  depends on TRACE
  bool "Enable exception tracer (waiting for the implementation)"
  default n


config DIFFTEST
  bool "Enable differential testing"
  default n

config WATCHPOINT
  bool "Enable watchpoint"
  default n

endmenu

choice 
  prompt "Wave"
  default NO_WAVE
config NO_WAVE
  bool "no wave"
config VCD
  bool "vcd"
config FST
  bool "fst"
config WAVE_BEGIN
  depends on VCD || FST
  int "Instruction dump begin"
  default 0
config WAVE_END
  depends on VCD || FST
  int "Instruction dump end (to keep dumping, set -1)"
  default 10000
endchoice

menuconfig DEVICE
  bool "Devices"
  default n

if DEVICE

config HAS_PORT_IO
  bool
  default n

menuconfig HAS_SERIAL
  bool "Enable serial"
  default y

if HAS_SERIAL
config SERIAL_PORT
  depends on HAS_PORT_IO
  hex "Port address of the serial controller"
  default 0x3f8

config SERIAL_MMIO
  hex "MMIO address of the serial controller"
  default 0xa00003f8

config SERIAL_INPUT_FIFO
  bool "Enable input FIFO with /tmp/nemu.serial"
  default n
endif # HAS_SERIAL

menuconfig HAS_TIMER
  bool "Enable timer"
  default n

if HAS_TIMER
config RTC_PORT
  depends on HAS_PORT_IO
  hex "Port address of the timer"
  default 0x48

config RTC_MMIO
  hex "MMIO address of the timer"
  default 0xa0000048
endif # HAS_TIMER

menuconfig HAS_KEYBOARD
  bool "Enable keyboard"
  default n

if HAS_KEYBOARD
config I8042_DATA_PORT
  depends on HAS_PORT_IO
  hex "Port address of the keyboard controller"
  default 0x60

config I8042_DATA_MMIO
  hex "MMIO address of the keyboard controller"
  default 0xa0000060
endif # HAS_KEYBOARD

menuconfig HAS_VGA
  bool "Enable VGA"
  default n

if HAS_VGA
config FB_ADDR
  hex "Physical address of the VGA frame buffer"
  default 0xa1000000

config VGA_CTL_PORT
  depends on HAS_PORT_IO
  hex "Port address of the VGA controller"
  default 0x100

config VGA_CTL_MMIO
  hex "MMIO address of the VGA controller"
  default 0xa0000100

config VGA_SHOW_SCREEN
  bool "Enable SDL SCREEN"
  default y

choice
  prompt "Screen Size"
  default VGA_SIZE_400x300
config VGA_SIZE_400x300
  bool "400 x 300"
config VGA_SIZE_800x600
  bool "800 x 600"
endchoice
endif # HAS_VGA

if !TARGET_AM
menuconfig HAS_AUDIO
  bool "Enable audio"
  default n

if HAS_AUDIO
config SB_ADDR
  hex "Physical address of the audio stream buffer"
  default 0xa1200000

config SB_SIZE
  hex "Size of the audio stream buffer"
  default 0x10000

config AUDIO_CTL_PORT
  depends on HAS_PORT_IO
  hex "Port address of the audio controller"
  default 0x200

config AUDIO_CTL_MMIO
  hex "MMIO address of the audio controller"
  default 0xa0000200
endif # HAS_AUDIO

menuconfig HAS_DISK
  bool "Enable disk"
  default n

if HAS_DISK
config DISK_CTL_PORT
  depends on HAS_PORT_IO
  hex "Port address of the disk controller"
  default 0x300

config DISK_CTL_MMIO
  hex "MMIO address of the disk controller"
  default 0xa0000300

config DISK_IMG_PATH
  string "The path of disk image"
  default ""
endif # HAS_DISK

menuconfig HAS_SDCARD
  bool "Enable sdcard"
  default n

if HAS_SDCARD
config SDCARD_CTL_MMIO
  hex "MMIO address of the sdcard controller"
  default 0xa3000000

config SDCARD_IMG_PATH
  string "The path of sdcard image"
  default ""
endif # HAS_SDCARD
endif

endif

config SIM_FREQ_M
  int "Simulation frequency (MHz)"
  range 1 1000
  default 100

menu "Simulation Configuration"
  config TOP_MODULE
    string "Top module"
    default "Top"
  config IGNORE_WARNINGS
    bool "Ignore warning of verilator(In fact, not all when warnings enabled)"
    default n
endmenu
```
